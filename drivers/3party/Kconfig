## drivers/3party/Kconfig
```kconfig
menu "3-party drivers"
menu "Aircrack"
source "drivers/3party/rtl8188eus/Kconfig"
source "drivers/3party/rtl8812au/Kconfig"
endmenu
endmenu
```

## drivers/aircrack/Kconfig
```kconfig
source "rtl8812au/Kconfig"

source "rtl8188eus/Kconfig"

source "rtl8188fu/Kconfig"

source "rtl8192eu/Kconfig"
```
